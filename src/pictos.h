/*-----------------------------------------------------------*/

static lv_obj_t *icon_battery_obj;
// Original data in Flash
static const uint8_t icon_battery_map[] = {
    0x1b, 0x0b, 0xfd, 0xff, 	/*Color of index 0*/
    0x11, 0x05, 0xba, 0xff, 	/*Color of index 1*/
    0x06, 0x02, 0x6e, 0xff, 	/*Color of index 2*/
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    0x00, 0x00, 0x00, 0x00, 0x00, 0x00, 0x00, 0x00, 0x00, 0x00, 0x00, 0x00, 0x00, 0x00, 0x00, 0x00, 0x00, 0x00, 0x00, 0x00, 
  };

// Global image descriptor
lv_img_dsc_t icon_battery;

// Function to initialize the image in PSRAM
void init_icon_battery(void) {
    // Allocate memory in PSRAM
    uint8_t *psram_data = (uint8_t *)heap_caps_malloc(sizeof(icon_battery_map), MALLOC_CAP_SPIRAM);
    if (psram_data == NULL) {
        ESP_LOGE("ICON", "Failed to allocate PSRAM for icon_battery");
        return;
    }
    // Copy data from Flash to PSRAM
    memcpy(psram_data, icon_battery_map, sizeof(icon_battery_map));
    
    // Initialize the image descriptor
    icon_battery.header.cf = LV_IMG_CF_INDEXED_2BIT;
    icon_battery.header.always_zero = 0;
    icon_battery.header.reserved = 0;
    icon_battery.header.w = 80;
    icon_battery.header.h = 34;
    icon_battery.data_size = sizeof(icon_battery_map);
    icon_battery.data = psram_data;
}

/*-----------------------------------------------------------*/

/*-----------------------------------------------------------*/

static lv_obj_t *icon_huile_obj;
// Original data in Flash
static const uint8_t icon_huile_map[] = {
    0x1b, 0x0b, 0xfd, 0xff, 	/*Color of index 0*/
    0x11, 0x07, 0xba, 0xff, 	/*Color of index 1*/
    0x05, 0x02, 0x66, 0xff, 	/*Color of index 2*/
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    0x00, 0x00, 0x00, 0x00, 0x00, 0x00, 0x00, 0x00, 0x00, 0x00, 0x00, 0x00, 0x00, 0x00, 0x00, 0x00, 0x00, 0x00, 0x00, 0x00, 
  };

// Global image descriptor
lv_img_dsc_t icon_huile;

// Function to initialize the image in PSRAM
void init_icon_huile(void) {
    // Allocate memory in PSRAM
    uint8_t *psram_data = (uint8_t *)heap_caps_malloc(sizeof(icon_huile_map), MALLOC_CAP_SPIRAM);
    if (psram_data == NULL) {
        ESP_LOGE("ICON", "Failed to allocate PSRAM for icon_huile");
        return;
    }
    // Copy data from Flash to PSRAM
    memcpy(psram_data, icon_huile_map, sizeof(icon_huile_map));
    
    // Initialize the image descriptor
    icon_huile.header.cf = LV_IMG_CF_INDEXED_2BIT;
    icon_huile.header.always_zero = 0;
    icon_huile.header.reserved = 0;
    icon_huile.header.w = 80;
    icon_huile.header.h = 34;
    icon_huile.data_size = sizeof(icon_huile_map);
    icon_huile.data = psram_data;
}

/*-----------------------------------------------------------*/

/*-----------------------------------------------------------*/

static lv_obj_t *icon_freinR_obj;
// Original data in Flash
static const uint8_t icon_freinR_map[] = {
    0x1b, 0x0b, 0xfd, 0xff, 	/*Color of index 0*/
    0x12, 0x06, 0xbd, 0xff, 	/*Color of index 1*/
    0x05, 0x02, 0x64, 0xff, 	/*Color of index 2*/
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    0x00, 0x00, 0x00, 0x00, 0x00, 0x00, 0x00, 0x00, 0x00, 0x00, 0x00, 0x00, 0x00, 0x00, 0x00, 0x00, 0x00, 0x00, 0x00, 0x00, 
  };

// Global image descriptor
lv_img_dsc_t icon_freinR;

// Function to initialize the image in PSRAM
void init_icon_freinR(void) {
    // Allocate memory in PSRAM
    uint8_t *psram_data = (uint8_t *)heap_caps_malloc(sizeof(icon_freinR_map), MALLOC_CAP_SPIRAM);
    if (psram_data == NULL) {
        ESP_LOGE("ICON", "Failed to allocate PSRAM for icon_freinR");
        return;
    }
    // Copy data from Flash to PSRAM
    memcpy(psram_data, icon_freinR_map, sizeof(icon_freinR_map));
    
    // Initialize the image descriptor
    icon_freinR.header.cf = LV_IMG_CF_INDEXED_2BIT;
    icon_freinR.header.always_zero = 0;
    icon_freinR.header.reserved = 0;
    icon_freinR.header.w = 80;
    icon_freinR.header.h = 34;
    icon_freinR.data_size = sizeof(icon_freinR_map);
    icon_freinR.data = psram_data;
}

/*-----------------------------------------------------------*/

/*-----------------------------------------------------------*/

static lv_obj_t *icon_freinO_obj;
// Original data in Flash
static const uint8_t icon_freinO_map[] = {
    0x02, 0x9e, 0xfe, 0xff, 	/*Color of index 0*/
    0x01, 0x75, 0xbd, 0xff, 	/*Color of index 1*/
    0x00, 0x3b, 0x64, 0xff, 	/*Color of index 2*/
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    0x00, 0x00, 0x00, 0x00, 0x00, 0x00, 0x00, 0x00, 0x00, 0x00, 0x00, 0x00, 0x00, 0x00, 0x00, 0x00, 0x00, 0x00, 0x00, 0x00, 
  };

// Global image descriptor
lv_img_dsc_t icon_freinO;

// Function to initialize the image in PSRAM
void init_icon_freinO(void) {
    // Allocate memory in PSRAM
    uint8_t *psram_data = (uint8_t *)heap_caps_malloc(sizeof(icon_freinO_map), MALLOC_CAP_SPIRAM);
    if (psram_data == NULL) {
        ESP_LOGE("ICON", "Failed to allocate PSRAM for icon_freinO");
        return;
    }
    // Copy data from Flash to PSRAM
    memcpy(psram_data, icon_freinO_map, sizeof(icon_freinO_map));
    
    // Initialize the image descriptor
    icon_freinO.header.cf = LV_IMG_CF_INDEXED_2BIT;
    icon_freinO.header.always_zero = 0;
    icon_freinO.header.reserved = 0;
    icon_freinO.header.w = 80;
    icon_freinO.header.h = 34;
    icon_freinO.data_size = sizeof(icon_freinO_map);
    icon_freinO.data = psram_data;
}

/*-----------------------------------------------------------*/

/*-----------------------------------------------------------*/

static lv_obj_t *icon_degivre_obj;
// Original data in Flash
static const uint8_t icon_degivre_map[] = {
    0x02, 0x9f, 0xfe, 0xff, 	/*Color of index 0*/
    0x01, 0x7f, 0xce, 0xff, 	/*Color of index 1*/
    0x00, 0x50, 0x83, 0xff, 	/*Color of index 2*/
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    0x00, 0x00, 0x00, 0x00, 0x00, 0x00, 0x00, 0x00, 0x00, 0x00, 0x00, 0x00, 0x00, 0x00, 0x00, 0x00, 0x00, 0x00, 0x00, 0x00, 
  };

// Global image descriptor
lv_img_dsc_t icon_degivre;

// Function to initialize the image in PSRAM
void init_icon_degivre(void) {
    // Allocate memory in PSRAM
    uint8_t *psram_data = (uint8_t *)heap_caps_malloc(sizeof(icon_degivre_map), MALLOC_CAP_SPIRAM);
    if (psram_data == NULL) {
        ESP_LOGE("ICON", "Failed to allocate PSRAM for icon_degivre");
        return;
    }
    // Copy data from Flash to PSRAM
    memcpy(psram_data, icon_degivre_map, sizeof(icon_degivre_map));
    
    // Initialize the image descriptor
    icon_degivre.header.cf = LV_IMG_CF_INDEXED_2BIT;
    icon_degivre.header.always_zero = 0;
    icon_degivre.header.reserved = 0;
    icon_degivre.header.w = 80;
    icon_degivre.header.h = 34;
    icon_degivre.data_size = sizeof(icon_degivre_map);
    icon_degivre.data = psram_data;
}

/*-----------------------------------------------------------*/

/*-----------------------------------------------------------*/

static lv_obj_t *icon_essence_obj;
// Original data in Flash
static const uint8_t icon_essence_map[] = {
    0x02, 0x9e, 0xfe, 0xff, 	/*Color of index 0*/
    0x01, 0x82, 0xd2, 0xff, 	/*Color of index 1*/
    0x00, 0x39, 0x60, 0xff, 	/*Color of index 2*/
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    0x00, 0x00, 0x00, 0x00, 0x00, 0x00, 0x00, 0x00, 0x00, 0x00, 0x00, 0x00, 0x00, 0x00, 0x00, 0x00, 0x00, 0x00, 0x00, 0x00, 
  };

// Global image descriptor
lv_img_dsc_t icon_essence;

// Function to initialize the image in PSRAM
void init_icon_essence(void) {
    // Allocate memory in PSRAM
    uint8_t *psram_data = (uint8_t *)heap_caps_malloc(sizeof(icon_essence_map), MALLOC_CAP_SPIRAM);
    if (psram_data == NULL) {
        ESP_LOGE("ICON", "Failed to allocate PSRAM for icon_essence");
        return;
    }
    // Copy data from Flash to PSRAM
    memcpy(psram_data, icon_essence_map, sizeof(icon_essence_map));
    
    // Initialize the image descriptor
    icon_essence.header.cf = LV_IMG_CF_INDEXED_2BIT;
    icon_essence.header.always_zero = 0;
    icon_essence.header.reserved = 0;
    icon_essence.header.w = 80;
    icon_essence.header.h = 34;
    icon_essence.data_size = sizeof(icon_essence_map);
    icon_essence.data = psram_data;
}

/*-----------------------------------------------------------*/

/*-----------------------------------------------------------*/

static lv_obj_t *icon_phare_obj;
// Original data in Flash
static const uint8_t icon_phare_map[] = {
    0xf4, 0xfe, 0x03, 0xff, 	/*Color of index 0*/
    0xad, 0xb5, 0x01, 0xff, 	/*Color of index 1*/
    0x67, 0x6c, 0x00, 0xff, 	/*Color of index 2*/
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    0x00, 0x00, 0x00, 0x00, 0x00, 0x00, 0x00, 0x00, 0x00, 0x00, 0x00, 0x00, 0x00, 0x00, 0x00, 0x00, 0x00, 0x00, 0x00, 0x00, 
  };

// Global image descriptor
lv_img_dsc_t icon_phare;

// Function to initialize the image in PSRAM
void init_icon_phare(void) {
    // Allocate memory in PSRAM
    uint8_t *psram_data = (uint8_t *)heap_caps_malloc(sizeof(icon_phare_map), MALLOC_CAP_SPIRAM);
    if (psram_data == NULL) {
        ESP_LOGE("ICON", "Failed to allocate PSRAM for icon_phare");
        return;
    }
    // Copy data from Flash to PSRAM
    memcpy(psram_data, icon_phare_map, sizeof(icon_phare_map));
    
    // Initialize the image descriptor
    icon_phare.header.cf = LV_IMG_CF_INDEXED_2BIT;
    icon_phare.header.always_zero = 0;
    icon_phare.header.reserved = 0;
    icon_phare.header.w = 80;
    icon_phare.header.h = 34;
    icon_phare.data_size = sizeof(icon_phare_map);
    icon_phare.data = psram_data;
}

/*-----------------------------------------------------------*/

/*-----------------------------------------------------------*/

static lv_obj_t *icon_pleinPhare_obj;
// Original data in Flash
static const uint8_t icon_pleinPhare_map[] = {
    0xfe, 0x0d, 0x05, 0xff, 	/*Color of index 0*/
    0xc9, 0x09, 0x03, 0xff, 	/*Color of index 1*/
    0x77, 0x03, 0x01, 0xff, 	/*Color of index 2*/
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    0x00, 0x00, 0x00, 0x00, 0x00, 0x00, 0x00, 0x00, 0x00, 0x00, 0x00, 0x00, 0x00, 0x00, 0x00, 0x00, 0x00, 0x00, 0x00, 0x00, 
  };

// Global image descriptor
lv_img_dsc_t icon_pleinPhare;

// Function to initialize the image in PSRAM
void init_icon_pleinPhare(void) {
    // Allocate memory in PSRAM
    uint8_t *psram_data = (uint8_t *)heap_caps_malloc(sizeof(icon_pleinPhare_map), MALLOC_CAP_SPIRAM);
    if (psram_data == NULL) {
        ESP_LOGE("ICON", "Failed to allocate PSRAM for icon_pleinPhare");
        return;
    }
    // Copy data from Flash to PSRAM
    memcpy(psram_data, icon_pleinPhare_map, sizeof(icon_pleinPhare_map));
    
    // Initialize the image descriptor
    icon_pleinPhare.header.cf = LV_IMG_CF_INDEXED_2BIT;
    icon_pleinPhare.header.always_zero = 0;
    icon_pleinPhare.header.reserved = 0;
    icon_pleinPhare.header.w = 80;
    icon_pleinPhare.header.h = 34;
    icon_pleinPhare.data_size = sizeof(icon_pleinPhare_map);
    icon_pleinPhare.data = psram_data;
}

/*-----------------------------------------------------------*/

/*-----------------------------------------------------------*/

static lv_obj_t *icon_clignotant_obj;
// Original data in Flash
static const uint8_t icon_clignotant_map[] = {
    0xf4, 0xfe, 0x02, 0xff, 	/*Color of index 0*/
    0xb3, 0xba, 0x01, 0xff, 	/*Color of index 1*/
    0x55, 0x59, 0x00, 0xff, 	/*Color of index 2*/
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    0x00, 0x00, 0x00, 0x00, 0x00, 0x00, 0x00, 0x00, 0x00, 0x00, 0x00, 0x00, 0x00, 0x00, 0x00, 0x00, 0x00, 0x00, 0x00, 0x00, 
  };

// Global image descriptor
lv_img_dsc_t icon_clignotant;

// Function to initialize the image in PSRAM
void init_icon_clignotant(void) {
    // Allocate memory in PSRAM
    uint8_t *psram_data = (uint8_t *)heap_caps_malloc(sizeof(icon_clignotant_map), MALLOC_CAP_SPIRAM);
    if (psram_data == NULL) {
        ESP_LOGE("ICON", "Failed to allocate PSRAM for icon_clignotant");
        return;
    }
    // Copy data from Flash to PSRAM
    memcpy(psram_data, icon_clignotant_map, sizeof(icon_clignotant_map));
    
    // Initialize the image descriptor
    icon_clignotant.header.cf = LV_IMG_CF_INDEXED_2BIT;
    icon_clignotant.header.always_zero = 0;
    icon_clignotant.header.reserved = 0;
    icon_clignotant.header.w = 80;
    icon_clignotant.header.h = 34;
    icon_clignotant.data_size = sizeof(icon_clignotant_map);
    icon_clignotant.data = psram_data;
}

/*-----------------------------------------------------------*/